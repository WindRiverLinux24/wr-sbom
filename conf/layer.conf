## conf/layer.conf
```bitbake
# We have a conf and classes directory, add to BBPATH
BBPATH .= ":${LAYERDIR}"

# We have recipes-* directories, add to BBFILES
BBFILES += " \
    ${LAYERDIR}/recipes-*/*/*.bb \
    ${LAYERDIR}/recipes-*/*/*.bbappend \
    "

BBFILE_PATTERN_IGNORE_EMPTY_sbom = "1"

BBFILE_COLLECTIONS += "sbom"
BBFILE_PATTERN_sbom = "^${LAYERDIR}/"
LAYERVERSION_sbom = "1"

LAYERSERIES_COMPAT_sbom = "wrl mickledore"

# We want a higher priority than meta-python because there is
# at least one duplicate recipe.
#
BBFILE_PRIORITY_sbom = "10"

LAYERRECOMMENDS_sbom = "wr-sbom-dl (=4.0)"

LAYERDEPENDS_sbom = " \
    core \
    wrlinux \
    "

# extra licenses not found in other layers can be found here
LICENSE_PATH += "${LAYERDIR}/meta/files/common-licenses"
```
